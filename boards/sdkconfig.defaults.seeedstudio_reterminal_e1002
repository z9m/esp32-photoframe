## boards/sdkconfig.defaults.seeedstudio_reterminal_e1002
```kconfig
# Seeed Studio reTerminal E1002 Specifics
CONFIG_BOARD_DRIVER_SEEEDSTUDIO_RETERMINAL_E1002=y

# Flash Configuration (32MB with 80MHz QIO)
CONFIG_ESPTOOLPY_FLASHSIZE_32MB=y
CONFIG_ESPTOOLPY_FLASHSIZE="32MB"
CONFIG_ESPTOOLPY_FLASHFREQ_80M=y

# Internal flash storage (LittleFS)
CONFIG_USE_INTERNAL_FLASH_STORAGE=y
```

## boards/sdkconfig.defaults.seeedstudio_xiao_ee02
```kconfig
# Seeed XIAO EE02 Specifics
CONFIG_BOARD_DRIVER_SEEEDSTUDIO_XIAO_EE02=y

# Flash Configuration
CONFIG_ESPTOOLPY_FLASHSIZE_16MB=y
CONFIG_ESPTOOLPY_FLASHSIZE="16MB"

# Internal flash storage (LittleFS)
CONFIG_USE_INTERNAL_FLASH_STORAGE=y
```

## sdkconfig.defaults.seeedstudio_xiao_ee02
```kconfig
# Seeed XIAO EE02 Specifics
CONFIG_BOARD_DRIVER_SEEEDSTUDIO_XIAO_EE02=y

# Flash Configuration
CONFIG_ESPTOOLPY_FLASHSIZE_16MB=y
CONFIG_ESPTOOLPY_FLASHSIZE="16MB"
```

## sdkconfig.defaults.seeedstudio_xiao_ee04
```kconfig
# Seeed XIAO EE04 Specifics
CONFIG_BOARD_DRIVER_SEEEDSTUDIO_XIAO_EE04=y

# Flash Configuration
CONFIG_ESPTOOLPY_FLASHSIZE_16MB=y
CONFIG_ESPTOOLPY_FLASHSIZE="16MB"
```
